## board/stm32n6_alientek_dnn647/configs/nsh/defconfig
```kconfig
#
# STM32N6 Alientek DNN647 NSH defconfig
#
CONFIG_ARCH="arm"
CONFIG_ARCH_BOARD="contest2026_463_board"
CONFIG_ARCH_BOARD_CONTEST2026_463_BOARD=y
CONFIG_ARCH_CHIP="stm32"
CONFIG_ARCH_CHIP_STM32=y
CONFIG_ARCH_CHIP_ARM_CUSTOM=y
CONFIG_ARCH_CHIP_CUSTOM=y
CONFIG_ARCH_CHIP_CUSTOM_NAME="stm32n6"
CONFIG_ARCH_CHIP_CUSTOM_DIR="../../contest2026_463_tongyuanjiang/chip/stm32n6"
CONFIG_ARCH_CHIP_CUSTOM_DIR_RELPATH=y
CONFIG_ARCH_CHIP_STM32N657X0=y
CONFIG_ARCH_CORTEXM33=y
CONFIG_ARCH_FPU=y
CONFIG_ARCH_INTERRUPTSTACK=4096
CONFIG_ARCH_STACKDUMP=y
CONFIG_BOARD_LOOPSPERMSEC=21000
CONFIG_BUILTIN=y
CONFIG_HAVE_CXX=y
CONFIG_HAVE_CXXINITIALIZE=y
CONFIG_IDLETHREAD_STACKSIZE=4096
CONFIG_INIT_ENTRYPOINT="nsh_main"
CONFIG_NSH_BUILTIN_APPS=y
CONFIG_NSH_FILEIOSIZE=512
CONFIG_NSH_READLINE=y
CONFIG_RAM_SIZE=4193280
CONFIG_RAM_START=0x34000400
CONFIG_RAW_BINARY=y
CONFIG_RR_INTERVAL=200
CONFIG_SCHED_WAITPID=y
CONFIG_STM32_USART1=y
CONFIG_STM32_STM32N6XXXX=y
CONFIG_SYSTEM_NSH=y
CONFIG_USART1_SERIAL_CONSOLE=y
CONFIG_DEBUG_SYMBOLS=y
```

## chip/stm32n6/Kconfig
```kconfig
#
# For a description of the syntax of this configuration file,
# see the file kconfig-language.txt in the NuttX tools repository.
#

comment "STM32N6 Configuration Options"

config STM32_N6_PERIPHERALS
        bool
        default y

config STM32_STM32N6XXXX
        bool
        default y

config ARCH_CHIP_STM32N657X0
        bool "STM32N657X0"
        select STM32_STM32N6XXXX
        select ARCH_CORTEXM55
        select ARCH_HAVE_FPU
        select ARCH_FPU
        select ARCH_HAVE_LEDS

config STM32_USART
        bool
        default n

config STM32_SERIALDRIVER
        bool
        default n

config STM32_USART1
        bool "USART1"
        default n
        select STM32_USART

config STM32_USART2
        bool "USART2"
        default n
        select STM32_USART

config STM32_USART3
        bool "USART3"
        default n
        select STM32_USART

config STM32N6_USART1_SERIALDRIVER
        bool "USART1 standard serial driver"
        default y
        depends on STM32_USART1
        select USART1_SERIALDRIVER
        select ARCH_HAVE_SERIAL_TERMIOS
        select STM32_SERIALDRIVER

config STM32N6_USART2_SERIALDRIVER
        bool "USART2 standard serial driver"
        default y
        depends on STM32_USART2
        select USART2_SERIALDRIVER
        select ARCH_HAVE_SERIAL_TERMIOS
        select STM32_SERIALDRIVER

config STM32N6_USART3_SERIALDRIVER
        bool "USART3 standard serial driver"
        default y
        depends on STM32_USART3
        select USART3_SERIALDRIVER
        select ARCH_HAVE_SERIAL_TERMIOS
        select STM32_SERIALDRIVER
```
